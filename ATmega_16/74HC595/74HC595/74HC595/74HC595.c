/*
 * _74HC595.c
 *
 * Created: 10/22/2015 11:07:52 AM
 *  Author: Administrator
 */
#include <avr/io.h>
#define F_CPU 16000000UL
#include <util/delay.h>
#define setb(thanhghi,bit)	thanhghi=thanhghi|(1<<bit)
#define clrb(thanhghi,bit)  thanhghi=thanhghi&(~(1<<bit))
#define inbit(thanhghi,bit) (thanhghi&(1<<bit))>>bit
#define PORT PORTD
#define DDR DDRD
int chuoi[100];
int ma[]={
	 0xFF,0xFF,0xFF,0xFF,0xFF,0xFF,//SPACE-32
	 0xFF,0xFF,0xA0,0xFF,0xFF,0xFF,//!    33
	 0xFF,0xFF,0xF8,0xF4,0xFF,0xFF,//"    34
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	 0xFF,0xFF,0xF8,0xF4,0xFF,0xFF,//'    96
 /*0xDF,0xAB,0xAB,0xAB,0xC7,0xFF,//a    97
 0x80,0xC7,0xBB,0xBB,0xC7,0xFF,//b  98
 0xFF,0xC7,0xBB,0xBB,0xBB,0xFF,//c  99
 0xC7,0xBB,0xBB,0xC7,0x80,0xFF,//d  100
 0xC7,0xAB,0xAB,0xAB,0xF7,0xFF,//e    101
 0xF7,0x81,0xF6,0xF6,0xFD,0xFF,//f  102
 0xF7,0xAB,0xAB,0xAB,0xC3,0xFF,//g    103
 0x80,0xF7,0xFB,0xFB,0x87,0xFF,//h    104
 0xFF,0xBB,0x82,0xBF,0xFF,0xFF,//i    105
 0xDF,0xBF,0xBB,0xC2,0xFF,0xFF,//j    106
 0xFF,0x80,0xEF,0xD7,0xBB,0xFF,//k    107
 0xFF,0xBE,0x80,0xBF,0xFF,0xFF,//l    108
 0x83,0xFB,0x87,0xFB,0x87,0xFF,//m    109
 0x83,0xF7,0xFB,0xFB,0x87,0xFF,//n    110
 0xC7,0xBB,0xBB,0xBB,0xC7,0xFF,//o    111
 0x83,0xEB,0xEB,0xEB,0xF7,0xFF,//p    112
 0xF7,0xEB,0xEB,0xEB,0x83,0xFF,//q    113
 0x83,0xF7,0xFB,0xFB,0xF7,0xFF,//r    114
 0xB7,0xAB,0xAB,0xAB,0xDB,0xFF,//s    115
 0xFF,0xFB,0xC0,0xBB,0xBB,0xFF,//t    116
 0xC3,0xBF,0xBF,0xDF,0x83,0xFF,//u    117
 0xE3,0xDF,0xBF,0xDF,0xE3,0xFF,//v    118
 0xC3,0xBF,0xCF,0xBF,0xC3,0xFF,//w    119
 0xBB,0xD7,0xEF,0xD7,0xBB,0xFF,//x    120
 0xF3,0xAF,0xAF,0xAF,0xC3,0xFF,//y    121
 0xBB,0x9B,0xAB,0xB3,0xBB,0xFF,//z    122
 0xFB,0xE1,0xE0,0xE1,0xFB,0xFF//^    123*/
};//5 hang 10 cot:[5][10];

void ship(long data)
{
	for (int i=24;i>0;i--)
	{
		if((data&0x800000)==0x800000)
		setb(PORT,0);
		else
		clrb(PORT,0);
		data=data<<1;
		clrb(PORT,1);//xung clk cua thanh ghi dich
		setb(PORT,1);
	}
		clrb(PORT,2);//xung clk cua thanh ghi dich
		setb(PORT,2);
		_delay_us(1200);
}
int main(void)
{
	PORT=0X00;
	DDR=0X07;
	DDRA=0XFF;
    while(1)
    {
		char* str="    FUCK YOU      ";
		for (int i=0; str[i]!=0; i++)
		{
			int b,ii;
			ii=6*i;
			b=(str[i]-32)*6;
			for (int z=ii;z<ii+6;z++)
			{
				chuoi[z]=ma[b];
				b++;
			}
		}
			for (int y=23;y<110;y++)
			{
				for (int z=0;z<6;z++)
				{
					long a=0x000001;
					for(int x=y;x>y-24;x--)
					{
						ship(a);
						PORTA=chuoi[x];
						a=(a<<1);
					}
				}
			}
		
	}
}
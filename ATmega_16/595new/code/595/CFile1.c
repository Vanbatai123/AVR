/*
 * _595vs8matrix.c
 *
 * Created: 11/13/2015 6:33:18 PM
 *  Author: PC
 */ 


#include <avr/io.h>
# define F_CPU 8000000UL
#include <util/delay.h>
int ctb1[104]={0xFF,0xFF,0xFF,0xFF,0xFF,0xFF,0xFF,0xFF,0xFF,0xFF,0xFF,0xFF,0xFF,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0xFF,0xFF};
int ctb2[104]={0xFF,0xFF,0xFF,0xFF,0xFF,0xFF,0xFF,0xFF,0xFF,0xFF,0xFF,0xFF,0xFF,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0xFF,0xFF};
#define setb(thanhghi, bit) thanhghi|=1<<bit
#define clrb(thanhghi, bit) thanhghi&=~(1<<bit)
#define inb(thanhghi, bit) (thanhghi&=(1<<bit))>>bit
#define hc PORTC
#define sh1 0
#define ds1 1
#define sh2 5
#define ds2	6
#define st 7

void naphang(void)
{
	clrb(hc,sh2);
	setb(hc,sh2);
}
void chothang(void)
{
	clrb(hc,st);
	setb(hc,st);
}
void napcot(void)
{
	clrb(hc,sh1);
	setb(hc,sh1);
}	

void xuathang(int a,int b)
{ int m,n,i;
	m=a;n=b;
	for (i=15;i>=0;i--)
	{m=a;n=b;
		if(i>=8) 
		{
			if(inb(n,i-8)==1) setb(hc,ds2);
			else clrb(hc,ds2);
		}
		else
		 {
			if(inb(m,i)==1) setb(hc,ds2);
			else clrb(hc,ds2);
		 }
		 naphang();
	}
	chothang();
	
	
	
}





		
int main(void)
{ DDRC=0xff;
	PORTC=0xff;
	char i,j,k;
    while(1)
    {
      for (j=0;j<73;j++)
      {for(k=0;k<5;k++)
		  {
		    for(i=0;i<33;i++)
		    {
			   
				    if(i==0) setb(hc,ds1);
				    else clrb(hc,ds1);
				    napcot();
				    xuathang(ctb1[i+j],ctb2[i+j]);
					_delay_us(500);
			    }
		    }
      }
		//TODO:: Please write your application code 
    }
}